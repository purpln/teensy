__sram       = 0x20200000;
__sram_size  = 512k;
__itcm       = 0x00000000;
__itcm_size  = 512k;
__dtcm       = 0x20000000;
__dtcm_size  = 512k;
__flash      = 0x60000000;
__flash_size = 7936K;
__stack_size = 2k;
__null_size  = 1k;

INCLUDE linker.ld